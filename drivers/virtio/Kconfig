## drivers/virtio/Kconfig
```kconfig
# Copyright (c) 2024 Antmicro <www.antmicro.com>
# SPDX-License-Identifier: Apache-2.0

menuconfig VIRTIO
	bool "Support for VIRTIO"
	help
	  Enable options for VIRTIO

if VIRTIO

module = VIRTIO
module-str = VIRTIO
source "subsys/logging/Kconfig.template.log_config"

config VIRTIO_PCI
	bool "Support for VIRTIO over PCI"
	default y
	depends on DT_HAS_VIRTIO_PCI_ENABLED
	select PCIE
	help
	  Enable options for VIRTIO over PCI

config VIRTIO_MMIO
	bool "Support for VIRTIO over MMIO"
	default y
	depends on DT_HAS_VIRTIO_MMIO_ENABLED
	help
	  Enable options for VIRTIO over MMIO

config VIRTIO_RESTRICTED_DMA_POOL
	bool "Confine devices to restricted DMA pools"
	depends on DT_HAS_RESTRICTED_DMA_POOL_ENABLED
	default y
	select SYS_MEM_BLOCKS
	help
	  When the devicetree node of a VIRTIO transport references a
	  restricted-dma-pool node through its memory-region property,
	  allocate its virtqueues from that pool and bounce the buffers added
	  to them through it, so that the device never accesses any other
	  memory. This is needed when the device is implemented by another
	  virtual machine that can only access the memory shared with it. One
	  pool is created per restricted-dma-pool node and is shared by the
	  devices that reference it. Transports without the property keep
	  using the system heap and hand the driver buffers to the device
	  directly.

	  Every transfer costs a copy, and the copy of the data the device
	  returns runs in the transport's interrupt handler. The pool is
	  accessed through the cache like any other memory: the device must be
	  cache coherent with the CPU.

config VIRTIO_RESTRICTED_DMA_POOL_BLOCK_SIZE
	int "Allocation granularity of restricted DMA pools"
	depends on VIRTIO_RESTRICTED_DMA_POOL
	range 16 65536
	default 64
	help
	  Size in bytes of the blocks a restricted DMA pool is allocated in.
	  Must be a power of two of at least 16 bytes (the alignment required
	  by the descriptor table).

config HEAP_MEM_POOL_ADD_SIZE_VIRTIO
	int "Heap memory pool size for VIRTIO"
	default 32768
	help
	  Set the size of the heap memory pool for VIRTIO.

endif # VIRTIO
```

## dts/bindings/reserved-memory/restricted-dma-pool.yaml
```yaml
# SPDX-FileCopyrightText: Copyright The Zephyr Project Contributors
# SPDX-License-Identifier: Apache-2.0

description: |
  Memory pool for devices that may only access a restricted part of memory.

  Devices that reference the node through a memory-region property have
  their device-accessible data (for VirtIO: the virtqueues and bounce
  copies of the driver buffers) allocated from this region and never
  access any other memory. This is needed for devices implemented by
  another virtual machine, which only maps the memory shared with it.
  Several devices may reference the same pool, which is then shared
  between them.

  The compatible, the placement under /reserved-memory and the
  memory-region reference follow the Linux binding of the same name.

  The node must also be a zephyr,memory-region so that the linker keeps
  the rest of the image out of it, and it must not overlap the RAM the
  kernel manages. The pool is handed to the device by its own address, so
  it must be identity mapped. That is the case without an MMU, and on
  AArch64, which maps zephyr,memory-region nodes flat when they carry a
  zephyr,memory-attr property; other architectures with an MMU are not
  supported. The pool is accessed through the cache like any other memory,
  so the device must be cache coherent with the CPU.

  Example:

    reserved-memory {
        #address-cells = <1>;
        #size-cells = <1>;
        ranges;

        virtio_shm: restricted-dma-pool@d0000000 {
            compatible = "restricted-dma-pool", "zephyr,memory-region";
            reg = <0xd0000000 DT_SIZE_K(64)>;
            zephyr,memory-region = "VIRTIO_SHM";
        };
    };

    virtio_mmio0: virtio_mmio@a003e00 {
        compatible = "virtio,mmio";
        memory-region = <&virtio_shm>;
        ...
    };

compatible: "restricted-dma-pool"

include: "zephyr,memory-common.yaml"

properties:
  zephyr,memory-region:
    required: true
```

## dts/bindings/virtio/virtio,mmio.yaml
```yaml
# Copyright (c) 2025 TOKITA Hiroshi
# SPDX-License-Identifier: Apache-2.0

description: VIRTIO over MMIO

compatible: "virtio,mmio"

include: [base.yaml]

properties:
  memory-region:
    type: phandle
    description: |
      restricted-dma-pool node with the memory the device is allowed to
      access. When set, the virtqueues are allocated from that pool and the
      buffers of the device drivers are bounced through it, so the device
      never accesses any other memory. Use it when the device is implemented
      by another virtual machine that only maps the memory shared with it.
      Several devices may reference the same pool.
```
